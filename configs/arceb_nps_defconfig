## configs/arceb_nps_defconfig
```kconfig
BR2_arceb=y
BR2_nps400=y
# BR2_ARC_ATOMIC_EXT is not set
BR2_DL_DIR="$(TOPDIR)/.."
BR2_TOOLCHAIN_BUILDROOT_VENDOR="ezchip"
BR2_TOOLCHAIN_BUILDROOT_STATIC=y
BR2_KERNEL_HEADERS_VERSION=y
BR2_DEFAULT_KERNEL_VERSION="arc-4.0-ezchip"
BR2_PACKAGE_HOST_LINUX_HEADERS_CUSTOM_4_0=y
BR2_UCLIBC_VERSION_ARC_EZCHIP=y
BR2_UCLIBC_CONFIG="$(TOPDIR)/../configs/uClibc.config"
BR2_TOOLCHAIN_BUILDROOT_INET_RPC=y
BR2_TOOLCHAIN_BUILDROOT_WCHAR=y
BR2_PTHREAD_DEBUG=y
BR2_PACKAGE_HOST_GDB=y
BR2_TARGET_GENERIC_HOSTNAME="EZdk"
BR2_TARGET_GENERIC_ISSUE="Welcome to EZdk"
# BR2_TARGET_GENERIC_GETTY is not set
BR2_ROOTFS_OVERLAY="$(TOPDIR)/../rootfs_overlay"
BR2_LINUX_KERNEL=y
BR2_LINUX_KERNEL_SAME_AS_HEADERS=y
BR2_LINUX_KERNEL_DEFCONFIG="nps"
BR2_LINUX_KERNEL_DTS_SUPPORT=y
BR2_LINUX_KERNEL_INTREE_DTS_NAME="eznps"
BR2_PACKAGE_BUSYBOX_CONFIG="$(TOPDIR)/../configs/busybox.config"
BR2_PACKAGE_GDB=y
BR2_PACKAGE_STRACE=y
BR2_TARGET_ROOTFS_CPIO=y
# BR2_TARGET_ROOTFS_TAR is not set
BR2_TARGET_UBOOT=y
BR2_TARGET_UBOOT_BOARDNAME="nps400"
BR2_TARGET_UBOOT_CUSTOM_VERSION=y
BR2_TARGET_UBOOT_CUSTOM_VERSION_VALUE="arc-2015.04-ezchip"
BR2_TARGET_UBOOT_SPL=y
```

## configs/nsimosci_700_defconfig
```kconfig
BR2_arcle=y
BR2_ENABLE_DEBUG=y
BR2_DEBUG_3=y
BR2_OPTIMIZE_0=y
BR2_UCLIBC_CUSTOM_REPO_VERSION="arc-mainline-dev"
BR2_TOOLCHAIN_BUILDROOT_LARGEFILE=y
BR2_TOOLCHAIN_BUILDROOT_INET_IPV6=y
BR2_TOOLCHAIN_BUILDROOT_INET_RPC=y
BR2_TOOLCHAIN_BUILDROOT_WCHAR=y
BR2_PTHREAD_DEBUG=y
BR2_UCLIBC_INSTALL_TEST_SUITE=y
BR2_BINUTILS_VERSION_GIT=y
BR2_BINUTILS_CUSTOM_REPO_URL="git://github.com/T-J-Teru/synopsys-binutils-gdb"
BR2_BINUTILS_CUSTOM_REPO_VERSION="arc-2.23-tls-v3"
BR2_GCC_CUSTOM_REPO_URL="git://github.com/T-J-Teru/synopsys-gcc"
BR2_GCC_CUSTOM_REPO_VERSION="arc-4.8-tls-v2"
BR2_TOOLCHAIN_BUILDROOT_CXX=y
BR2_PACKAGE_HOST_GDB=y
BR2_TARGET_OPTIMIZATION="-O0"
BR2_ROOTFS_OVERLAY="$(TOPDIR)/../skeleton"
BR2_LINUX_KERNEL=y
BR2_LINUX_KERNEL_CUSTOM_GIT=y
BR2_LINUX_KERNEL_CUSTOM_REPO_URL="https://github.com/foss-for-synopsys-dwc-arc-processors/linux"
BR2_LINUX_KERNEL_CUSTOM_REPO_VERSION="arc-3.13"
BR2_LINUX_KERNEL_DEFCONFIG="nsimosci"
BR2_LINUX_KERNEL_VMLINUX=y
BR2_PACKAGE_GDB=y
BR2_PACKAGE_QT=y
BR2_PACKAGE_QT_DEBUG=y
BR2_PACKAGE_QT_DEMOS=y
BR2_PACKAGE_QT_EXAMPLES=y
BR2_PACKAGE_QT_LICENSE_APPROVED=y
BR2_PACKAGE_QT_PIXEL_DEPTH_1=y
BR2_PACKAGE_QT_PIXEL_DEPTH_4=y
BR2_PACKAGE_QT_PIXEL_DEPTH_12=y
BR2_PACKAGE_QT_PIXEL_DEPTH_15=y
BR2_PACKAGE_QT_PIXEL_DEPTH_18=y
BR2_PACKAGE_QT_PIXEL_DEPTH_24=y
BR2_PACKAGE_QT_QTFREETYPE=y
BR2_PACKAGE_QT_QTJPEG=y
BR2_PACKAGE_QT_QTPNG=y
BR2_PACKAGE_QT_QTTIFF=y
BR2_PACKAGE_QT_SVG=y
BR2_PACKAGE_QT_WEBKIT=y
BR2_TARGET_ROOTFS_INITRAMFS=y
```

## package/binutils/Config.in.host
```kconfig
comment "Binutils Options"

choice
	prompt "Binutils Version"
	default BR2_BINUTILS_VERSION_2_24 if BR2_microblaze || BR2_powerpc64le
	default BR2_BINUTILS_VERSION_2_22
	help
	  Select the version of binutils you wish to use.

	config BR2_BINUTILS_VERSION_2_18_AVR32_1_0_1
		depends on BR2_avr32
		bool "binutils 2.18-avr32-1.0.1"

	config BR2_BINUTILS_VERSION_2_22
		depends on !BR2_avr32 && !BR2_aarch64 && !BR2_microblaze && !BR2_powerpc64le && !BR2_arc
		bool "binutils 2.22"

	# bfin disabled for newer binutils due to
	# https://sourceware.org/bugzilla/show_bug.cgi?id=17334
	config BR2_BINUTILS_VERSION_2_23_2
		depends on !BR2_avr32 && !BR2_aarch64 && !BR2_bfin && !BR2_microblaze && !BR2_powerpc64le && !BR2_arc
		bool "binutils 2.23.2"

	config BR2_BINUTILS_VERSION_2_24
		depends on !BR2_avr32 && !BR2_bfin && !BR2_arc
		bool "binutils 2.24"

	config BR2_BINUTILS_VERSION_GIT
		bool "binutils from git repository"

endchoice

if BR2_BINUTILS_VERSION_GIT

config BR2_BINUTILS_CUSTOM_REPO_URL
	string "URL of binutils repository"
        default "https://github.com/foss-for-synopsys-dwc-arc-processors/binutils-gdb" if BR2_arc
	help
          URL for git repository to use.

config BR2_BINUTILS_CUSTOM_REPO_VERSION
	string "Version from binutils repository"
	default "arc-2014.08"	if BR2_arc
	help
	  Revision to use in the typical format used by Git/Mercurial
	  E.G. a sha id, a tag, branch, ..

endif

config BR2_BINUTILS_VERSION
	string
        default BR2_BINUTILS_CUSTOM_REPO_VERSION if BR2_BINUTILS_VERSION_GIT
	default "2.18-avr32-1.0.1" if BR2_BINUTILS_VERSION_2_18_AVR32_1_0_1
	default "2.22"		if BR2_BINUTILS_VERSION_2_22
	default "2.23.2"	if BR2_BINUTILS_VERSION_2_23_2
	default "2.24"		if BR2_BINUTILS_VERSION_2_24

config BR2_BINUTILS_EXTRA_CONFIG_OPTIONS
	string "Additional binutils options"
	default ""
	help
	  Any additional binutils options you may want to include.
```
